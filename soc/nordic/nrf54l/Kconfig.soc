## soc/nordic/nrf54l/Kconfig.soc
```kconfig
# Nordic Semiconductor nRF54L MCU line

# Copyright (c) 2024 Nordic Semiconductor ASA
# SPDX-License-Identifier: Apache-2.0

config SOC_NRF54L09
	bool
	select SOC_SERIES_NRF54LX
	help
	  NRF54L09

config SOC_NRF54L09_ENGA
	bool
	select SOC_NRF54L09
	help
	  NRF54L09 ENGA

config SOC_NRF54L09_ENGA_CPUAPP
	bool
	select SOC_NRF54L09_ENGA
	help
	  NRF54L09 ENGA CPUAPP

config SOC_NRF54L09_ENGA_CPUFLPR
	bool
	select SOC_NRF54L09_ENGA
	help
	  NRF54L09 ENGA CPUFLPR

config SOC_NRF54L20
	bool
	select SOC_SERIES_NRF54LX
	help
	  NRF54L20

config SOC_NRF54L20_ENGA
	bool
	select SOC_NRF54L20
	help
	  NRF54L20 ENGA

config SOC_NRF54L20_ENGA_CPUAPP
	bool
	select SOC_NRF54L20_ENGA
	help
	  NRF54L20 ENGA CPUAPP

config SOC_NRF54L20_ENGA_CPUFLPR
	bool
	select SOC_NRF54L20_ENGA
	help
	  NRF54L20 ENGA CPUFLPR

config SOC_NRF54LM20A
	bool
	select SOC_SERIES_NRF54LX
	help
	  NRF54LM20A

config SOC_NRF54LM20A_ENGA
	bool
	select SOC_NRF54LM20A
	help
	  NRF54LM20A ENGA

config SOC_NRF54LM20A_ENGA_CPUAPP
	bool
	select SOC_NRF54LM20A_ENGA
	help
	  NRF54LM20A ENGA CPUAPP

config SOC_NRF54LM20A_ENGA_CPUFLPR
	bool
	select SOC_NRF54LM20A_ENGA
	help
	  NRF54LM20A ENGA CPUFLPR

config SOC
	default "nrf54l09" if SOC_NRF54L09
	default "nrf54l20" if SOC_NRF54L20
	default "nrf54lm20a" if SOC_NRF54LM20A
```
