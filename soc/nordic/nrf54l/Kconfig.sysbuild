## soc/nordic/nrf54l/Kconfig.sysbuild
```kconfig
# Copyright (c) 2025 Nordic Semiconductor ASA
# SPDX-License-Identifier: Apache-2.0

if SOC_NRF54L05_CPUFLPR || SOC_NRF54L10_CPUFLPR || SOC_NRF54L15_CPUFLPR

config HAS_NORDIC_VPR_LAUNCHER_IMAGE
	default y

endif
```
